## main/Kconfig.projbuild
```kconfig
menu "Weather display configuration"

config OPENWEATHER_API_KEY
    string "OpenWeatherMap API key"
    default ""
    help
        API key for OpenWeatherMap Current Weather and Air Pollution APIs.
        Do not commit the key to source control.

config WEATHER_LATITUDE
    string "Weather latitude"
    default "22.317573"
    help
        Latitude used for weather and air-pollution requests.

config WEATHER_LONGITUDE
    string "Weather longitude"
    default "73.142594"
    help
        Longitude used for weather and air-pollution requests.

config WEATHER_UPDATE_INTERVAL_MIN
    int "Weather update interval (minutes)"
    range 1 180
    default 10

endmenu

menu "Ethernet network configuration"
config ETH_USE_STATIC_IP
    bool "Use Static IP instead of DHCP"
    default n
    help
        Enable this if a rogue DHCP server on your switch is assigning the wrong subnet (e.g. 192.168.2.x),
        or if you want a reliable fixed IP directly on your router's 192.168.1.x subnet.
config ETH_STATIC_IP_ADDR
    string "Static IPv4 address"
    depends on ETH_USE_STATIC_IP
    default "192.168.1.222"
    help
        Static IP address to assign to the ESP32 Ethernet interface.
config ETH_STATIC_NETMASK
    string "Static IPv4 netmask"
    depends on ETH_USE_STATIC_IP
    default "255.255.255.0"
    help
        Subnet mask for the static IP address.
config ETH_STATIC_GATEWAY
    string "Static IPv4 gateway"
    depends on ETH_USE_STATIC_IP
    default "192.168.1.1"
    help
        Default gateway IP (your main router).
config ETH_STATIC_DNS_MAIN
    string "Static primary DNS server"
    depends on ETH_USE_STATIC_IP
    default "192.168.1.1"
    help
        Primary DNS server (e.g. 192.168.1.1 or 8.8.8.8).
config ETH_STATIC_DNS_BACKUP
    string "Static backup DNS server"
    depends on ETH_USE_STATIC_IP
    default "8.8.8.8"
    help
        Backup DNS server (e.g. 8.8.8.8).
endmenu
```
